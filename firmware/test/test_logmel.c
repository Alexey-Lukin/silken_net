// SPDX-License-Identifier: AGPL-3.0-or-later
/*
 * test_logmel.c — Host parity test for Compute_LogMel (FW.25, docs/03_03 §3.4).
 *
 * Asserts the C front-end reproduces the silken_ml golden vectors (generated by
 * the pure-stdlib oracle, itself parity-gated against librosa at tol 1e-6) within
 * tol 1e-3, plus structural properties (silence/DC floor, periodic-Hann endpoints,
 * mel-bank sparsity, tone localization).
 *
 * Build: make -C firmware/test logmel
 */
#include <stdio.h>
#include <math.h>

#include "../common/logmel.h"
#include "../common/logmel_hann_table.h"
#include "../common/logmel_mel_bank.h"
#include "../common/logmel_golden_vectors.h"

#ifndef M_PI
#define M_PI 3.14159265358979323846
#endif

#define TOL        1e-3f
#define FLOOR_LOG  logf(LOGMEL_LOG_FLOOR)   /* ln(1e-6) ≈ -13.8155 */

static int tests_run = 0, tests_failed = 0;

#define TEST(name) static void name(void)
#define RUN(name) do { int _p = tests_failed; tests_run++; name(); \
    printf("  %-46s %s\n", #name, tests_failed == _p ? "✅" : "❌"); } while (0)
#define ASSERT_TRUE(cond) do { if (!(cond)) { \
    printf("    FAIL %s:%d — condition false\n", __func__, __LINE__); \
    tests_failed++; return; } } while (0)
#define ASSERT_NEAR(a, b, eps) do { if (fabs((double)(a) - (double)(b)) > (eps)) { \
    printf("    FAIL %s:%d — expected %.6f, got %.6f (eps %.1e)\n", \
           __func__, __LINE__, (double)(b), (double)(a), (double)(eps)); \
    tests_failed++; return; } } while (0)

/* ── 1. Golden-vector parity (the canonical gate) ─────────────────────────── */
TEST(test_golden_vectors_parity)
{
    for (int g = 0; g < LOGMEL_GOLDEN_COUNT; g++) {
        float out[LOGMEL_N_MELS];
        Compute_LogMel(LOGMEL_GOLDEN[g].input, out);
        for (int m = 0; m < LOGMEL_N_MELS; m++) {
            float d = fabsf(out[m] - LOGMEL_GOLDEN[g].expected[m]);
            if (d > TOL) {
                printf("    FAIL golden[%s] band %d: expected %.6f got %.6f (Δ=%.2e)\n",
                       LOGMEL_GOLDEN[g].name, m, LOGMEL_GOLDEN[g].expected[m], out[m], d);
                tests_failed++;
                return;
            }
        }
    }
}

/* ── 2. Properties ────────────────────────────────────────────────────────── */
TEST(test_silence_is_floor)
{
    float in[LOGMEL_N_FFT] = {0}, out[LOGMEL_N_MELS];
    Compute_LogMel(in, out);
    for (int m = 0; m < LOGMEL_N_MELS; m++) ASSERT_NEAR(out[m], FLOOR_LOG, 1e-3);
}

TEST(test_dc_offset_removed)
{
    /* Constant 0.5 → per-frame DC removal collapses to silence (§3.4 fix). */
    float in[LOGMEL_N_FFT], out[LOGMEL_N_MELS];
    for (int i = 0; i < LOGMEL_N_FFT; i++) in[i] = 0.5f;
    Compute_LogMel(in, out);
    for (int m = 0; m < LOGMEL_N_MELS; m++) ASSERT_NEAR(out[m], FLOOR_LOG, 1e-3);
}

TEST(test_periodic_hann_table)
{
    ASSERT_NEAR(LOGMEL_HANN[0], 0.0f, 1e-7);              /* periodic → starts at 0 */
    ASSERT_NEAR(LOGMEL_HANN[LOGMEL_N_FFT / 2], 1.0f, 1e-6); /* peak at N/2 */
    ASSERT_TRUE(LOGMEL_HANN[1] > 0.0f);
}

TEST(test_mel_bank_sparse_valid)
{
    ASSERT_TRUE(LOGMEL_MEL_NNZ > 0 && LOGMEL_MEL_NNZ < LOGMEL_N_MELS * LOGMEL_N_BINS);
    for (int t = 0; t < LOGMEL_MEL_NNZ; t++) {
        ASSERT_TRUE(LOGMEL_MEL_BANK[t].m < LOGMEL_N_MELS);
        ASSERT_TRUE(LOGMEL_MEL_BANK[t].k < LOGMEL_N_BINS);
        ASSERT_TRUE(LOGMEL_MEL_BANK[t].w > 0.0f);
    }
}

TEST(test_tone_localizes_energy)
{
    float in[LOGMEL_N_FFT], out[LOGMEL_N_MELS];
    float f = 64.0f * LOGMEL_SR / LOGMEL_N_FFT;   /* 2 kHz → FFT bin 64 */
    for (int i = 0; i < LOGMEL_N_FFT; i++)
        in[i] = 0.5f + 0.4f * sinf(2.0f * (float)M_PI * f * (float)i / (float)LOGMEL_SR);
    Compute_LogMel(in, out);
    float mx = out[0];
    for (int m = 1; m < LOGMEL_N_MELS; m++) if (out[m] > mx) mx = out[m];
    ASSERT_TRUE(mx > FLOOR_LOG + 5.0f);
}

int main(void)
{
    printf("\n══════════════════════════════════════════════════════════════\n");
    printf("  Compute_LogMel host tests (FW.25, docs/03_03 §3.4)\n");
    printf("══════════════════════════════════════════════════════════════\n");
    RUN(test_golden_vectors_parity);
    RUN(test_silence_is_floor);
    RUN(test_dc_offset_removed);
    RUN(test_periodic_hann_table);
    RUN(test_mel_bank_sparse_valid);
    RUN(test_tone_localizes_energy);
    printf("\n  Results: %d passed, %d failed\n\n", tests_run - tests_failed, tests_failed);
    return tests_failed ? 1 : 0;
}
